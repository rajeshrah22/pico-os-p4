PROVIDE(SIO			= 0xd0000000);
PROVIDE(IO_BANK0	= 0x40014000);
PROVIDE(RESETS		= 0x4000c000);
PROVIDE(PADS_BANK0	= 0x4001c000);
PROVIDE(UART0		= 0x40034000);
PROVIDE(UART1		= 0x40038000);
PROVIDE(CLOCKS		= 0x40008000);
PROVIDE(XOSC		= 0x40024000);
PROVIDE(PLL_SYS		= 0x40028000);
PROVIDE(SPI0		= 0x4003c000);
PROVIDE(SPI1		= 0x40040000);
PROVIDE(PIO0		= 0x50200000);
PROVIDE(PIO1		= 0x50300000);

PROVIDE_HIDDEN(PPB_BASE	= 0xe0000000);
PROVIDE(NVIC_ISER	= PPB_BASE + 0xe100);
PROVIDE(NVIC_ICER	= PPB_BASE + 0xe180);
PROVIDE(NVIC_ISPR	= PPB_BASE + 0xe200);
PROVIDE(NVIC_ICPR	= PPB_BASE + 0xe280);
PROVIDE(NVIC_IPR	= PPB_BASE + 0xe400);
PROVIDE(MPU			= PPB_BASE + 0xed90);
PROVIDE(SYSTICK		= PPB_BASE + 0xe010);
PROVIDE(SYSCTRL		= PPB_BASE + 0xed00);
